## src/systemcmds/aaci_contactor/Kconfig
```kconfig
menuconfig SYSTEMCMDS_AACI_CONTACTOR
	bool "aaci_contactor"
	default n
	---help---
		Enable one-shot AACI contactor command over CAN2.
```

## src/systemcmds/can_dump/Kconfig
```kconfig
menuconfig SYSTEMCMDS_CAN_DUMP
	bool "can_dump"
	default n
	---help---
		Enable support for dumping legacy NuttX CAN character devices such as
		/dev/can0 on STM32F7 boards.
```

## src/systemcmds/esc_can_bench/Kconfig
```kconfig
menuconfig SYSTEMCMDS_ESC_CAN_BENCH
	bool "esc_can_bench"
	default n
	---help---
		Enable a small bench utility that periodically publishes dummy ESC telemetry
		as extended CAN frames via a legacy NuttX CAN character device such as /dev/can0.
```

## src/systemcmds/esc_can_decoder/Kconfig
```kconfig
menuconfig SYSTEMCMDS_ESC_CAN_DECODER
	bool "esc_can_decoder"
	default n
	---help---
		Enable a bench utility on STM32H7 boards that receives raw ESC telemetry
		from CAN2 and republishes it as esc_status and battery_status uORB topics.
```
